## conf/machine/orangepi5.conf
```bitbake
# Copyright (c) 2023, M. Maidson
# Released under the MIT license (see COPYING.MIT for the terms)

#@TYPE: Machine
#@NAME: Orange Pi 5

require conf/machine/include/rk3588.inc

KERNEL_DEVICETREE = "rockchip/rk3588s-orangepi-5.dtb"
KERNEL_IMAGETYPES = "Image boot.img"
KERNEL_IMAGETYPE = "Image"
KERNEL_IMAGETYPE_FOR_MAKE = "${@os.path.splitext(os.path.basename(d.getVar('KERNEL_DEVICETREE')))[0] + '.img'}"

UBOOT_MACHINE = "orangepi_5_defconfig"

PREFERRED_PROVIDER_virtual/kernel = "linux-orangepi"
PREFERRED_PROVIDER_virtual/bootloader = "u-boot-orangepi"
PREFERRED_PROVIDER_u-boot = "u-boot-orangepi"

RK_WIFIBT_FIRMWARES = ""
MACHINE_FEATURES = "alsa ext2 ext3 usbhost"
IMAGE_BOOT_FILES = "${KERNEL_IMAGETYPE} ${@' '.join([os.path.basename(f) + ';rockchip/' + os.path.basename(f) for f in d.getVar('KERNEL_DEVICETREE').split()])}"
WKS_FILE = "opi5-sdcard.wks"
```
